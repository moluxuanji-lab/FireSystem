## firmware/boards/lince/kzb_f407/Kconfig
```kconfig
config KZB_EARLY_SAFE_IO
	bool "Clamp KZB safety relay outputs and RS485 DE low before kernel init"
	default y
	depends on BOARD_KZB_F407
```

## firmware/boards/lince/kzb_f407/board.yml
```yaml
board:
  name: kzb_f407
  full_name: Lince KZB-V1.1 STM32F407ZE Controller
  vendor: lince
  socs:
    - name: stm32f407xx
```
